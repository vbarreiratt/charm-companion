## config/sdkconfig.defaults
```kconfig
# ESP-IDF Configuration for Charm Companion
CONFIG_ESPTOOLPY_FLASHSIZE_32MB=y
CONFIG_SPIRAM=y
CONFIG_SPIRAM_MODE_OCT=y
CONFIG_SPIRAM_SPEED_80MHZ=y
CONFIG_ESP32S3_INSTRUCTION_CACHE_32KB=y
CONFIG_ESP32S3_DATA_CACHE_64KB=y
CONFIG_ESP32S3_DATA_CACHE_LINE_64B=y

# Build
CONFIG_ESP_TASK_WDT_TIMEOUT_S=10
CONFIG_LOG_DEFAULT_LEVEL=INFO
CONFIG_FREERTOS_HZ=1000

# Display & LVGL (for future phases)
CONFIG_LVGL_USE_LOG=y
```
